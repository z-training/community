## prj.conf
```kconfig
# GPIO support for LED control
CONFIG_GPIO=y

# Thread configuration
CONFIG_THREAD_NAME=y
CONFIG_INIT_STACKS=y
CONFIG_THREAD_STACK_INFO=y

# Enable console
CONFIG_CONSOLE=y
CONFIG_UART_CONSOLE=y

# Increase main stack size for initialization
CONFIG_MAIN_STACK_SIZE=2048

# Enable Tracing with Percepio View
CONFIG_TRACING=y
CONFIG_PERCEPIO_TRACERECORDER=y
CONFIG_PERCEPIO_TRC_CFG_STREAM_PORT_RINGBUFFER=y
CONFIG_PERCEPIO_TRC_CFG_STREAM_PORT_RINGBUFFER_SIZE=8196
```

## src/event_thread.c
```c
/*
 * Copyright (c) 2024 Beningo Embedded Group
 *
 * SPDX-License-Identifier: Apache-2.0
 */

/**
 * @file event_thread.c
 * @brief Event-Driven Thread Implementation (Starter)
 */

#include "event_thread.h"
#include "sync_mgr.h"
#include <zephyr/kernel.h>
#include <zephyr/drivers/gpio.h>

#define EVENT_THREAD_STACK_SIZE     1024
#define EVENT_THREAD_PRIORITY       6

#define LED0_NODE DT_ALIAS(led0)

static K_THREAD_STACK_DEFINE(event_thread_stack, EVENT_THREAD_STACK_SIZE);
static struct k_thread event_thread_data;

static uint32_t event_count = 0;
static const struct gpio_dt_spec led = GPIO_DT_SPEC_GET(LED0_NODE, gpios);

static int gpio_init(void)
{
    int ret;

    if (!gpio_is_ready_dt(&led)) {
        printk("[Event Thread] ERROR: LED device not ready\n");
        return -ENODEV;
    }

    ret = gpio_pin_configure_dt(&led, GPIO_OUTPUT_INACTIVE);
    if (ret < 0) {
        printk("[Event Thread] ERROR: Failed to configure LED\n");
        return ret;
    }

    return 0;
}

static void event_thread_entry(void *arg1, void *arg2, void *arg3)
{
    int ret;

    ARG_UNUSED(arg1);
    ARG_UNUSED(arg2);
    ARG_UNUSED(arg3);

    printk("[Event Thread] Started\n");

    ret = gpio_init();
    if (ret < 0) {
        printk("[Event Thread] GPIO init failed\n");
        return;
    }

    printk("[Event Thread] Waiting for events...\n");

    while (1) {
        ret = sync_mgr_wait_event(K_FOREVER);

        if (ret == 0) {
            event_count++;
            gpio_pin_toggle_dt(&led);
            printk("[Event Thread] Event #%u received - LED toggled\n",
                event_count);
        }
    }
}

int event_thread_init(void)
{
    k_tid_t tid;

    tid = k_thread_create(&event_thread_data,
                          event_thread_stack,
                          K_THREAD_STACK_SIZEOF(event_thread_stack),
                          event_thread_entry,
                          NULL, NULL, NULL,
                          EVENT_THREAD_PRIORITY,
                          0,
                          K_NO_WAIT);

    if (tid == NULL) {
        printk("[Event Thread] ERROR: Failed to create thread\n");
        return -1;
    }
    else {
        k_thread_name_set(tid, "Event Thread");
    }

    printk("[Event Thread] Initialized\n");
    return 0;
}
```

## src/event_thread.h
```c
/*
 * Copyright (c) 2024 Beningo Embedded Group
 *
 * SPDX-License-Identifier: Apache-2.0
 */

/**
 * @file event_thread.h
 * @brief Event-Driven Thread Module (Starter)
 */

#ifndef EVENT_THREAD_H
#define EVENT_THREAD_H

#include <zephyr/kernel.h>

int event_thread_init(void);

#endif /* EVENT_THREAD_H */
```

## src/periodic_thread.c
```c
/*
 * Copyright (c) 2024 Beningo Embedded Group
 *
 * SPDX-License-Identifier: Apache-2.0
 */

/**
 * @file periodic_thread.c
 * @brief Periodic Thread Implementation (Starter)
 */

#include "periodic_thread.h"
#include "sync_mgr.h"
#include <zephyr/kernel.h>

#define PERIODIC_THREAD_STACK_SIZE  1024
#define PERIODIC_THREAD_PRIORITY    7
#define PERIOD_MS                   2000

static K_THREAD_STACK_DEFINE(periodic_thread_stack, PERIODIC_THREAD_STACK_SIZE);
static struct k_thread periodic_thread_data;

static uint32_t execution_count = 0;

static void periodic_thread_entry(void *arg1, void *arg2, void *arg3)
{
    ARG_UNUSED(arg1);
    ARG_UNUSED(arg2);
    ARG_UNUSED(arg3);

    printk("[Periodic Thread] Started\n");

    while (1) {
        execution_count++;

        printk("[Periodic Thread] Execution #%u - Signaling event thread\n", execution_count);

        sync_mgr_signal_event();

        k_msleep(PERIOD_MS);
    }
}

int periodic_thread_init(void)
{
    k_tid_t tid;

    tid = k_thread_create(&periodic_thread_data,
                          periodic_thread_stack,
                          K_THREAD_STACK_SIZEOF(periodic_thread_stack),
                          periodic_thread_entry,
                          NULL, NULL, NULL,
                          PERIODIC_THREAD_PRIORITY,
                          0,
                          K_NO_WAIT);

    if (tid == NULL) {
        printk("[Periodic Thread] ERROR: Failed to create thread\n");
        return -1;
    } 
    else {
        k_thread_name_set(tid, "Periodic Thread");
    }

    printk("[Periodic Thread] Initialized\n");
    return 0;
}
```

## src/sync_mgr.c
```c
/*
 * Copyright (c) 2024 Beningo Embedded Group
 *
 * SPDX-License-Identifier: Apache-2.0
 */

/**
 * @file sync_mgr.c
 * @brief Synchronization Manager Implementation (Starter)
 */

#include "sync_mgr.h"
#include <zephyr/kernel.h>

/* 
 * Initial count should be 0 (no events pending at startup)
 * Limit should be 1 (binary semaphore)
 */
static K_SEM_DEFINE(event_sem, 0, 1);

int sync_mgr_init(void)
{
    printk("[Sync Manager] Initialized\n");
    return 0;
}

void sync_mgr_signal_event(void)
{
    k_sem_give(&event_sem);
}

int sync_mgr_wait_event(k_timeout_t timeout)
{
    return k_sem_take(&event_sem, timeout);
}
```

## src/sync_mgr.h
```c
/*
 * Copyright (c) 2024 Beningo Embedded Group
 *
 * SPDX-License-Identifier: Apache-2.0
 */

/**
 * @file sync_mgr.h
 * @brief Synchronization Manager Module (Starter)
 */

#ifndef SYNC_MGR_H
#define SYNC_MGR_H

#include <zephyr/kernel.h>

/**
 * @brief Initialize the synchronization manager
 */
int sync_mgr_init(void);

/**
 * @brief Signal the event semaphore
 */
void sync_mgr_signal_event(void);

/**
 * @brief Wait for the event semaphore
 */
int sync_mgr_wait_event(k_timeout_t timeout);

#endif /* SYNC_MGR_H */
```
