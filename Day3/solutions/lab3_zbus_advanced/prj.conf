## CMakeLists.txt
```
# SPDX-License-Identifier: Apache-2.0

cmake_minimum_required(VERSION 3.20.0)

find_package(Zephyr REQUIRED HINTS $ENV{ZEPHYR_BASE})
project(msgq)

include_directories(${CMAKE_CURRENT_SOURCE_DIR}/include)

target_sources(app PRIVATE
    src/main.c
    src/producer.c
    src/filter.c
    src/sub_consumer.c
    src/msub_consumer.c)
```

## prj.conf
```kconfig
CONFIG_TEST_RANDOM_GENERATOR=y

CONFIG_ZBUS=y
CONFIG_ZBUS_RUNTIME_OBSERVERS=y
CONFIG_ZBUS_MSG_SUBSCRIBER=y
```

## src/main.c
```c
/*
 * Copyright (c) 2025 Citrinio
 *
 * SPDX-License-Identifier: Apache-2.0
 */
#include "producer.h"

#include <zephyr/kernel.h>
#include <zephyr/zbus/zbus.h>

/* Declare an external channel to use that in this file */
ZBUS_CHAN_DECLARE(chan_raw_data, chan_data);
ZBUS_OBS_DECLARE(lis_filter, sub_consumer, msub_consumer);

static void enable_filter()
{

	printk("\n+ Enabling filter ========\n");
	producer_stop();
	zbus_chan_add_obs(&chan_raw_data, &lis_filter, K_FOREVER);
	zbus_chan_rm_obs(&chan_raw_data, &sub_consumer, K_FOREVER);
	zbus_chan_rm_obs(&chan_raw_data, &msub_consumer, K_FOREVER);
	zbus_chan_add_obs(&chan_data, &sub_consumer, K_FOREVER);
	zbus_chan_add_obs(&chan_data, &msub_consumer, K_FOREVER);
	producer_start();
}

static void disable_filter()
{
	printk("\n+ Disabling filter ========\n");
	producer_stop();
	zbus_chan_rm_obs(&chan_raw_data, &lis_filter, K_FOREVER);
	zbus_chan_add_obs(&chan_raw_data, &sub_consumer, K_FOREVER);
	zbus_chan_add_obs(&chan_raw_data, &msub_consumer, K_FOREVER);
	zbus_chan_rm_obs(&chan_data, &sub_consumer, K_FOREVER);
	zbus_chan_rm_obs(&chan_data, &msub_consumer, K_FOREVER);
	producer_start();
}

int main()
{
	k_sleep(K_SECONDS(2));
	while (true) {
		enable_filter();

		k_sleep(K_SECONDS(5));

		disable_filter();

		k_sleep(K_SECONDS(5));
	}
	return 0;
}
```

## include/producer.h
```c
/*
 * Copyright (c) 2025 Citrinio
 *
 * SPDX-License-Identifier: Apache-2.0
 */

void producer_start();
void producer_stop();
```

## src/filter.c
```c
/*
 * Copyright (c) 2025 Citrinio
 *
 * SPDX-License-Identifier: Apache-2.0
 */

#include <zephyr/kernel.h>
#include <zephyr/zbus/zbus.h>

/* Define the raw data channel of uint16_t type */
ZBUS_CHAN_DEFINE(chan_data, uint16_t, NULL, NULL, ZBUS_OBSERVERS_EMPTY, 0);

void lis_filter_callback(const struct zbus_channel *chan)
{
	const uint16_t *data = zbus_chan_const_msg(chan);

	printk(" -O- Filtering raw data: %d\n", *data);

	/* Filter messages bigger than 512 */
	if (*data > 512) {
		printk(" -x- Data %d is invalid\n", *data);
	} else {
		/* Publish the message in another channel to be consumed by another thread
		 */
		zbus_chan_pub(&chan_data, data, K_MSEC(500));
	}
}

/* Define the filter listener */
ZBUS_LISTENER_DEFINE(lis_filter, lis_filter_callback);
```

## src/msub_consumer.c
```c
/*
 * Copyright (c) 2025 Citrinio
 *
 * SPDX-License-Identifier: Apache-2.0
 */
#include <zephyr/kernel.h>
#include <zephyr/zbus/zbus.h>
#include <zephyr/zbus/zbus.h>

ZBUS_MSG_SUBSCRIBER_DEFINE(msub_consumer);

void msub_consumer_thread_entry(void *arg1, void *arg2, void *arg3)
{
	ARG_UNUSED(arg1);
	ARG_UNUSED(arg2);
	ARG_UNUSED(arg3);

	uint16_t data;
	const struct zbus_channel *chan;

	printk("MSG Subscriber consumer thread is running\n");

	while (1) {
		/* Wait for a notification for msub_consumer message subscriber */
		zbus_sub_wait_msg(&msub_consumer, &chan, &data, K_FOREVER);

		printk(" --> MSub consumed data: %d\n", data);
	}
}

/* Create the consumer thread */
K_THREAD_DEFINE(consumer_thread_id, 1024, msub_consumer_thread_entry, NULL, NULL, NULL, 3, 0, 0);
```

## src/producer.c
```c
/*
 * Copyright (c) 2025 Citrinio
 *
 * SPDX-License-Identifier: Apache-2.0
 */
#include <zephyr/kernel.h>
#include <zephyr/init.h>
#include <zephyr/zbus/zbus.h>
#include <zephyr/random/random.h>

/* Define the raw data channel with of uint16_t type */
ZBUS_CHAN_DEFINE(chan_raw_data, uint16_t, NULL, NULL, ZBUS_OBSERVERS_EMPTY, 0);

void timer_producer_handler(struct k_timer *timer_id)
{
	ARG_UNUSED(timer_id);

	uint16_t raw_data = sys_rand16_get() % 1024;

	printk("\n >-- Producing raw data: %d\n", raw_data);

	/* Publish the raw data message to the raw channel to be consumed by another thread */
	zbus_chan_pub(&chan_raw_data, &raw_data, K_MSEC(500));
}

K_TIMER_DEFINE(timer_producer, timer_producer_handler, NULL);

void producer_start()
{
	k_timer_start(&timer_producer, K_SECONDS(1), K_SECONDS(1));
}

void producer_stop()
{
	k_timer_stop(&timer_producer);
}
```

## src/sub_consumer.c
```c
/*
 * Copyright (c) 2025 Citrinio
 *
 * SPDX-License-Identifier: Apache-2.0
 */
#include <zephyr/kernel.h>
#include <zephyr/zbus/zbus.h>

ZBUS_SUBSCRIBER_DEFINE(sub_consumer, 4);

void sub_consumer_thread_entry(void *arg1, void *arg2, void *arg3)
{
	ARG_UNUSED(arg1);
	ARG_UNUSED(arg2);
	ARG_UNUSED(arg3);

	uint16_t data;
	const struct zbus_channel *chan;

	printk("Subscriber consumer thread is running\n");

	while (1) {
		/* Wait for the notification on the subcriber consumer */
		zbus_sub_wait(&sub_consumer, &chan, K_FOREVER);

		/* Read the channel to access the message */
		zbus_chan_read(chan, &data, K_MSEC(500));

		printk(" --> Sub consumed data: %d\n", data);
	}
}

/* Create the consumer thread */
K_THREAD_DEFINE(sub_consumer_thread_id, 1024, sub_consumer_thread_entry, NULL, NULL, NULL, 3, 0, 0);
```
