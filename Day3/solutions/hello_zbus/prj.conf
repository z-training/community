## CMakeLists.txt
```
# SPDX-License-Identifier: Apache-2.0

cmake_minimum_required(VERSION 3.20.0)

find_package(Zephyr REQUIRED HINTS $ENV{ZEPHYR_BASE})
project(msgq)

target_sources(app PRIVATE
    #src/hello_listener.c
    src/hello_subscriber.c
    #src/hello_msg_subscriber.c
)
```

## prj.conf
```kconfig
CONFIG_ZBUS=y
CONFIG_ZBUS_CHANNEL_NAME=y
CONFIG_ZBUS_MSG_SUBSCRIBER=y
```

## src/hello_listener.c
```c
/*
 * Copyright (c) 2025 Citrinio
 *
 * SPDX-License-Identifier: Apache-2.0
 */
#include <zephyr/kernel.h>
#include <zephyr/zbus/zbus.h>

void lis_callback(const struct zbus_channel *chan)
{
	const uint16_t *data = zbus_chan_const_msg(chan);
	printk("Hello Listener! Received %d from %s\n", *data, zbus_chan_name(chan));
}

ZBUS_LISTENER_DEFINE(lis_01, lis_callback);

ZBUS_CHAN_DEFINE(chan_01, uint16_t, NULL, NULL, ZBUS_OBSERVERS(lis_01), 0);

int main(void)
{
	uint16_t data = 10;

	zbus_chan_pub(&chan_01, &data, K_NO_WAIT);

	return 0;
}
```

## src/hello_msg_subscriber.c
```c
/*
 * Copyright (c) 2025 Citrinio
 *
 * SPDX-License-Identifier: Apache-2.0
 */
#include <stdint.h>
#include <zephyr/kernel.h>
#include <zephyr/zbus/zbus.h>

ZBUS_MSG_SUBSCRIBER_DEFINE(msub_01);

ZBUS_CHAN_DEFINE(chan_01, uint16_t, NULL, NULL, ZBUS_OBSERVERS(msub_01), 0);

int main(void)
{
	uint16_t data = 10;

	zbus_chan_pub(&chan_01, &data, K_NO_WAIT);

	return 0;
}

void zbus_subscriber_thread_main(void *p1, void *p2, void *p3)
{
	ARG_UNUSED(p1);
	ARG_UNUSED(p2);
	ARG_UNUSED(p3);

	uint16_t data;
	const struct zbus_channel *chan;

	while (1) {
		zbus_sub_wait_msg(&msub_01, &chan, &data, K_FOREVER);

		printk("Hello MSG Subscriber! Received %d from %s\n", data, zbus_chan_name(chan));
	}
}

K_THREAD_DEFINE(sub_thread, 1024, zbus_subscriber_thread_main, NULL, NULL, NULL, 4, 0, 0);
```

## src/hello_subscriber.c
```c
/*
 * Copyright (c) 2025 Citrinio
 *
 * SPDX-License-Identifier: Apache-2.0
 */
#include <stdint.h>
#include <zephyr/kernel.h>
#include <zephyr/zbus/zbus.h>

ZBUS_SUBSCRIBER_DEFINE(msub_01, 4);

ZBUS_CHAN_DEFINE(chan_01, uint16_t, NULL, NULL, ZBUS_OBSERVERS(msub_01), 0);

int main(void)
{
	uint16_t data = 10;

	zbus_chan_pub(&chan_01, &data, K_NO_WAIT);

	return 0;
}

void zbus_subscriber_thread_main(void *p1, void *p2, void *p3)
{
	ARG_UNUSED(p1);
	ARG_UNUSED(p2);
	ARG_UNUSED(p3);

	uint16_t data;
	const struct zbus_channel *chan;

	while (1) {
		zbus_sub_wait(&msub_01, &chan, K_FOREVER);

		zbus_chan_read(&chan_01, &data, K_NO_WAIT);

		printk("Hello Subscriber! Received %d from %s\n", data, zbus_chan_name(chan));
	}
}

K_THREAD_DEFINE(sub_thread, 1024, zbus_subscriber_thread_main, NULL, NULL, NULL, 4, 0, 0);
```
