## CMakeLists.txt
```
# SPDX-License-Identifier: Apache-2.0

cmake_minimum_required(VERSION 3.20.0)

find_package(Zephyr REQUIRED HINTS $ENV{ZEPHYR_BASE})
project(lab1_fifo_advanced)

include_directories(${CMAKE_CURRENT_SOURCE_DIR}/include)

target_sources(app PRIVATE src/producer.c src/filter.c src/consumer.c)
```

## prj.conf
```kconfig
CONFIG_TEST_RANDOM_GENERATOR=y
CONFIG_HEAP_MEM_POOL_SIZE=1024
```

## src/consumer.c
```c
/*
 * Copyright (c) 2025 Citrinio
 *
 * SPDX-License-Identifier: Apache-2.0
 */
#include <zephyr/kernel.h>
#include "data.h"

/* Declare an external message queue to use that in this file */
extern struct k_fifo fifo_data_filtered;
extern struct k_fifo fifo_data_free;

void consumer_thread_entry(void *arg1, void *arg2, void *arg3)
{
	ARG_UNUSED(arg1);
	ARG_UNUSED(arg2);
	ARG_UNUSED(arg3);

	printk("Consumer thread is running\n");

	while (1) {
		/* Get the data from an external message queue */
		struct data_item *data = k_fifo_get(&fifo_data_filtered, K_FOREVER);

		printk(" --> Consumed data: %d\n", data->value);

		k_fifo_put(&fifo_data_free, data);
	}
}

/* Create the consumer thread */
K_THREAD_DEFINE(consumer_thread_id, 1024, consumer_thread_entry, NULL, NULL, NULL, 2, 0, 0);
```

## src/filter.c
```c
/*
 * Copyright (c) 2025 Citrinio
 *
 * SPDX-License-Identifier: Apache-2.0
 */

#include <zephyr/kernel.h>
#include "data.h"
/* Declare an external message queue to use that in this file */
extern struct k_fifo fifo_data_used;
extern struct k_fifo fifo_data_free;

K_FIFO_DEFINE(fifo_data_filtered);

void filter_thread_entry(void *arg1, void *arg2, void *arg3)
{
	ARG_UNUSED(arg1);
	ARG_UNUSED(arg2);
	ARG_UNUSED(arg3);

	printk("Filter thread is running\n");

	while (1) {

		/* Get the raw data from an external message queue */
		struct data_item *raw_data = k_fifo_get(&fifo_data_used, K_FOREVER);

		printk(" -O- Filtering raw data: %d\n", raw_data->value);

		/* Filter messages bigger than 512 */
		if (raw_data->value > 512) {
			printk(" -x- Data %d is invalid\n", raw_data->value);
			k_fifo_put(&fifo_data_free, raw_data);
			continue;
		}

		/* Put the message in another message queue to be consumed by another thread
		 */

		k_fifo_put(&fifo_data_filtered, raw_data);
	}
}

/* Create the filter thread */
K_THREAD_DEFINE(filter_thread_id, 1024, filter_thread_entry, NULL, NULL, NULL, 3, 0, 0);
```

## src/producer.c
```c
/*
 * Copyright (c) 2025 Citrinio
 *
 * SPDX-License-Identifier: Apache-2.0
 */
#include <zephyr/kernel.h>
#include <zephyr/random/random.h>

#include "data.h"
/* Define the raw data message queue with 10 elements of uint16_t size and
 * alignment of 2 bytes */
K_FIFO_DEFINE(fifo_data_used);
K_FIFO_DEFINE(fifo_data_free);

static struct data_item data[4];

void producer_thread_entry(void *arg1, void *arg2, void *arg3)
{
	ARG_UNUSED(arg1);
	ARG_UNUSED(arg2);
	ARG_UNUSED(arg3);

	int i;

	for (i = 0; i < ARRAY_SIZE(data); i++) {
		k_fifo_put(&fifo_data_free, &data[i]);
	}

	printk("Producer thread is running\n");

	while (1) {
		struct data_item *raw_data = k_fifo_get(&fifo_data_free, K_FOREVER);

		raw_data->value = sys_rand16_get() % 1024;

		printk("\n >-- Producing raw data: %d\n", raw_data->value);

		/* Put the raw data to the message queue to be consumed by another thread */
		k_fifo_put(&fifo_data_used, raw_data);

		k_sleep(K_SECONDS(1));
	}
}

/* Create the producer thread */
K_THREAD_DEFINE(producer_thread_id, 1024, producer_thread_entry, NULL, NULL, NULL, 4, 0, 0);
```
