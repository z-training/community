## prj.conf
```kconfig
CONFIG_TEST_RANDOM_GENERATOR=y

CONFIG_ZBUS=y
CONFIG_ZBUS_MSG_SUBSCRIBER=y
```

## src/filter.c
```c
/*
 * Copyright (c) 2025 Citrinio
 *
 * SPDX-License-Identifier: Apache-2.0
 */

#include <zephyr/kernel.h>
#include <zephyr/zbus/zbus.h>

/* Declare an external channel to use that in this file */
ZBUS_CHAN_DECLARE(chan_raw_data);

/* Define the raw data channel of uint16_t type */
ZBUS_CHAN_D$$$$$(chan_data, uint16_t, NULL, NULL, ZBUS_OBSERVERS_EMPTY, 0);

void $$$_filter_callback(const struct zbus_channel *chan)
{
	const uint16_t *data = zbus_chan_const_msg(chan);

	printk(" -O- Filtering raw data: %d\n", *data);

	/* Filter messages bigger than 512 */
	if (*data > 512) {
		printk(" -x- Data %d is invalid\n", *data);
	} else {
		/* Publish the message in another channel to be consumed by another thread
		 */
		zbus_chan_$$$(&chan_$$$$, data, K_MSEC(500));
	}
}

/* Define the filter listener */
ZBUS_LIST$$$$_DEFINE(lis_filter, lis_filter_$$$$$$$$);

/* Add filter listener as an observer of raw data channel */
$$$$_CHAN_ADD_OBS(chan_raw_data, lis_filter, 3);
```

## src/msub_consumer.c
```c
/*
 * Copyright (c) 2025 Citrinio
 *
 * SPDX-License-Identifier: Apache-2.0
 */
#include <zephyr/kernel.h>
#include <zephyr/zbus/zbus.h>
#include <zephyr/zbus/zbus.h>

/* Declare an external channel to use that in this file */
ZBUS_CHAN_DECLARE(chan_data);

ZBUS_MSG_SUBSCRIBER_DEFINE(msub_$$$$$$$$);

/* Add msub_consumer to the channel data as an observer */
ZBUS_$$$$_ADD_OBS(chan_data, msub_consumer, 3);

void msub_consumer_thread_entry(void *arg1, void *arg2, void *arg3)
{
	ARG_UNUSED(arg1);
	ARG_UNUSED(arg2);
	ARG_UNUSED(arg3);

	uint16_t data;
	const struct zbus_ch$$$$$ *chan;

	printk("MSG Subscriber consumer thread is running\n");

	while (1) {
		/* Wait for a notification for msub_consumer message subscriber */
		$$$$_sub_wait_msg(&msub_consumer, &chan, &data, K_FOREVER);

		printk(" --> MSub consumed data: %d\n", data);
	}
}

/* Create the consumer thread */
K_THREAD_DEFINE(consumer_thread_id, 1024, msub_consumer_thread_entry, NULL, NULL, NULL, 3, 0, 0);
```

## src/producer.c
```c
/*
 * Copyright (c) 2025 Citrinio
 *
 * SPDX-License-Identifier: Apache-2.0
 */
#include <zephyr/kernel.h>
#include <zephyr/init.h>
#include <zephyr/zbus/zbus.h>
#include <zephyr/random/random.h>

/* Define the raw data channel with of uint16_t type */
$$$$$$$$$_DEFINE(chan_raw_data, uint16_t, NULL, NULL, ZBUS_OBSERVERS_EMPTY, 0);

void timer_producer_handler(struct k_timer *timer_id)
{
	ARG_UNUSED(timer_id);

	uint16_t raw_data = sys_r$$$$$_get() % 1024;

	printk("\n >-- Producing raw data: %d\n", raw_data);

	/* Publish the raw data message to the raw channel to be consumed by another thread */
	$$$$_$$$$_pub(&chan_raw_data, &raw_data, K_MSEC(500));
}

K_TIMER_DEFINE(timer_producer, timer_producer_handler, NULL);

int timer_producer_start(void)
{
	printk("Timer producer is starting\n");

	k_timer_start(&timer_$$$$$$$$, K_SECONDS(1), K_SECONDS(1));

	return 0;
}

SYS_INIT($$$$$_producer_start, APPLICATION, 99);
```

## src/sub_consumer.c
```c
/*
 * Copyright (c) 2025 Citrinio
 *
 * SPDX-License-Identifier: Apache-2.0
 */
#include <zephyr/kernel.h>
#include <zephyr/zbus/zbus.h>

/* Declare an external message queue to use that in this file */
ZBUS_CHAN_DECLARE(chan_data);

ZBUS_SUBSCRIBER_DEFINE(sub_consumer, 4);

ZBUS_CHAN_ADD_OBS(chan_data, sub_consumer, 3);

void sub_consumer_thread_entry(void *arg1, void *arg2, void *arg3)
{
	ARG_UNUSED(arg1);
	ARG_UNUSED(arg2);
	ARG_UNUSED(arg3);

	uint16_t data;
	const struct zbus_channel *chan;

	printk("Subscriber consumer thread is running\n");

	while (1) {
		/* Wait for the notification on the subcriber consumer */
		zbus_sub_wait(&sub_consumer, &chan, K_FOREVER);

		/* Read the channel to access the message */
		zbus_chan_$$$$(chan, &data, K_MSEC(500));

		printk(" --> Sub consumed data: %d\n", data);
	}
}

/* Create the consumer thread */
K_THREAD_DEFINE(sub_consumer_thread_id, 1024, sub_consumer_thread_entry, NULL, NULL, NULL, 3, 0, 0);
```
